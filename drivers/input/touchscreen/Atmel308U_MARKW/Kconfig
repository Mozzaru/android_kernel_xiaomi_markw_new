## drivers/input/touchscreen/Atmel308U_MARKW/Kconfig
```kconfig
config TOUCHSCREEN_ATMEL308U_MARKW
	tristate "ATMEL A308U touchpanel driver"
	depends on INPUT_TOUCHSCREEN
	default n
```

## drivers/input/touchscreen/FT5346_MARKW/Kconfig
```kconfig
config TOUCHSCREEN_FT5346_MARKW
	tristate "FOCALTECH FT5346 touchpanel driver"
	depends on INPUT_TOUCHSCREEN
	default n
```
